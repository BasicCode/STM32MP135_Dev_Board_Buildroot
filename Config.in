## Config.in
```kconfig
# GDEQ046T82 E-Ink Display
source "$BR2_EXTERNAL_STM32MP135_Dev_Board_Buildroot_PATH/package/gdeq046t82/Config.in"
```

## configs/stm32mp135_dev_board_defconfig
```kconfig
BR2_arm=y
BR2_cortex_a7=y
BR2_TOOLCHAIN_EXTERNAL=y
BR2_TOOLCHAIN_EXTERNAL_BOOTLIN=y
BR2_GLOBAL_PATCH_DIR="$(BR2_EXTERNAL_STM32MP135_Dev_Board_Buildroot_PATH)/board/stm32mp135_dev_board/patches"
BR2_ROOTFS_DEVICE_CREATION_DYNAMIC_EUDEV=y
BR2_ROOTFS_OVERLAY="$(BR2_EXTERNAL_STM32MP135_Dev_Board_Buildroot_PATH)/board/stm32mp135_dev_board/overlay/"
BR2_ROOTFS_POST_IMAGE_SCRIPT="$(BR2_EXTERNAL_STM32MP135_Dev_Board_Buildroot_PATH)/board/stm32mp135_dev_board/post-image.sh"
BR2_LINUX_KERNEL=y
BR2_LINUX_KERNEL_CUSTOM_TARBALL=y
BR2_LINUX_KERNEL_CUSTOM_TARBALL_LOCATION="$(call github,STMicroelectronics,linux)v6.1-stm32mp-r1.tar.gz"
BR2_LINUX_KERNEL_DEFCONFIG="multi_v7"
BR2_LINUX_KERNEL_CONFIG_FRAGMENT_FILES="$(LINUX_DIR)/arch/arm/configs/fragment-01-multiv7_cleanup.config $(LINUX_DIR)/arch/arm/configs/fragment-02-multiv7_addons.config"
BR2_LINUX_KERNEL_UIMAGE=y
BR2_LINUX_KERNEL_UIMAGE_LOADADDR="0xc2000000"
BR2_LINUX_KERNEL_DTS_SUPPORT=y
BR2_LINUX_KERNEL_INTREE_DTS_NAME="stm32mp135_dev_board"
BR2_LINUX_KERNEL_CUSTOM_DTS_PATH="$(BR2_EXTERNAL_STM32MP135_Dev_Board_Buildroot_PATH)/board/stm32mp135_dev_board/stm32mp135_dev_board.dts"
BR2_LINUX_KERNEL_DTB_OVERLAY_SUPPORT=y
BR2_LINUX_KERNEL_INSTALL_TARGET=y
BR2_LINUX_KERNEL_NEEDS_HOST_OPENSSL=y
BR2_PACKAGE_ALSA_UTILS=y
BR2_PACKAGE_ALSA_UTILS_ALSACONF=y
BR2_PACKAGE_ALSA_UTILS_ACONNECT=y
BR2_PACKAGE_ALSA_UTILS_ALSALOOP=y
BR2_PACKAGE_ALSA_UTILS_ALSAUCM=y
BR2_PACKAGE_ALSA_UTILS_ALSATPLG=y
BR2_PACKAGE_ALSA_UTILS_AMIDI=y
BR2_PACKAGE_ALSA_UTILS_AMIXER=y
BR2_PACKAGE_ALSA_UTILS_APLAY=y
BR2_PACKAGE_ALSA_UTILS_APLAYMIDI=y
BR2_PACKAGE_ALSA_UTILS_ARECORDMIDI=y
BR2_PACKAGE_ALSA_UTILS_ASEQDUMP=y
BR2_PACKAGE_ALSA_UTILS_ASEQNET=y
BR2_PACKAGE_ALSA_UTILS_BAT=y
BR2_PACKAGE_ALSA_UTILS_IECSET=y
BR2_PACKAGE_ALSA_UTILS_SPEAKER_TEST=y
BR2_PACKAGE_ATEST=y
BR2_PACKAGE_FAAD2=y
BR2_PACKAGE_FFMPEG=y
BR2_PACKAGE_FFMPEG_FFPLAY=y
BR2_PACKAGE_PULSEAUDIO=y
BR2_PACKAGE_PULSEAUDIO_DAEMON=y
BR2_PACKAGE_DHRYSTONE=y
BR2_PACKAGE_SPIDEV_TEST=y
BR2_PACKAGE_FLEX=y
BR2_PACKAGE_MAKE=y
BR2_PACKAGE_FONT_AWESOME=y
BR2_PACKAGE_LIBERATION=y
BR2_PACKAGE_CHOCOLATE_DOOM=y
BR2_PACKAGE_DOOM_WAD=y
BR2_PACKAGE_LIBVA_UTILS=y
BR2_PACKAGE_DIRECTFB=y
BR2_PACKAGE_DIRECTFB_DEBUG=y
BR2_PACKAGE_DIRECTFB_TRACE=y
BR2_PACKAGE_DIRECTFB_SAWMAN=y
BR2_PACKAGE_DIRECTFB_TIFF=y
BR2_PACKAGE_DIRECTFB_IMLIB2=y
BR2_PACKAGE_DIRECTFB_DITHER_RGB16=y
BR2_PACKAGE_DIRECTFB_TESTS=y
BR2_PACKAGE_DIRECTFB_EXAMPLES=y
BR2_PACKAGE_FBV=y
BR2_PACKAGE_LIBGLVND=y
BR2_PACKAGE_LITE=y
BR2_PACKAGE_SDL=y
BR2_PACKAGE_SDL_DIRECTFB=y
BR2_PACKAGE_SDL_GFX=y
BR2_PACKAGE_SDL_IMAGE=y
BR2_PACKAGE_SDL_IMAGE_GIF=y
BR2_PACKAGE_SDL_IMAGE_JPEG=y
BR2_PACKAGE_SDL_IMAGE_LBM=y
BR2_PACKAGE_SDL_IMAGE_PCX=y
BR2_PACKAGE_SDL_IMAGE_PNG=y
BR2_PACKAGE_SDL_IMAGE_PNM=y
BR2_PACKAGE_SDL_IMAGE_TARGA=y
BR2_PACKAGE_SDL_IMAGE_TIFF=y
BR2_PACKAGE_SDL_IMAGE_WEBP=y
BR2_PACKAGE_SDL_IMAGE_XCF=y
BR2_PACKAGE_SDL_IMAGE_XPM=y
BR2_PACKAGE_SDL_IMAGE_XV=y
BR2_PACKAGE_SDL_MIXER=y
BR2_PACKAGE_SDL_MIXER_MIDI_TIMIDITY=y
BR2_PACKAGE_SDL_NET=y
BR2_PACKAGE_SDL_SOUND=y
BR2_PACKAGE_SDL_SOUND_PLAYSOUND=y
BR2_PACKAGE_SDL_TTF=y
BR2_PACKAGE_SDL2_DIRECTFB=y
BR2_PACKAGE_SDL2_GFX=y
BR2_PACKAGE_SDL2_IMAGE=y
BR2_PACKAGE_SDL2_TTF=y
BR2_PACKAGE_VULKAN_HEADERS=y
BR2_PACKAGE_XORG7=y
BR2_PACKAGE_XSERVER_XORG_SERVER=y
BR2_PACKAGE_XCB_UTIL_CURSOR=y
BR2_PACKAGE_XCB_UTIL_KEYSYMS=y
BR2_PACKAGE_XCB_UTIL_WM=y
BR2_PACKAGE_XLIB_LIBFS=y
BR2_PACKAGE_XLIB_LIBXSCRNSAVER=y
BR2_PACKAGE_XLIB_LIBXFONT=y
BR2_PACKAGE_XLIB_LIBXVMC=y
BR2_PACKAGE_XLIB_LIBXXF86DGA=y
BR2_PACKAGE_XLIB_LIBDMX=y
BR2_PACKAGE_XAPP_OCLOCK=y
BR2_PACKAGE_XAPP_SETXKBMAP=y
BR2_PACKAGE_XAPP_TWM=y
BR2_PACKAGE_XAPP_XCLOCK=y
BR2_PACKAGE_XAPP_XCOMPMGR=y
BR2_PACKAGE_XAPP_XEV=y
BR2_PACKAGE_XAPP_XHOST=y
BR2_PACKAGE_XAPP_XINIT=y
BR2_PACKAGE_XAPP_XINPUT=y
BR2_PACKAGE_XAPP_XKBEVD=y
BR2_PACKAGE_XAPP_XKBPRINT=y
BR2_PACKAGE_XAPP_XKBUTILS=y
BR2_PACKAGE_XAPP_XKILL=y
BR2_PACKAGE_XAPP_XLOAD=y
BR2_PACKAGE_XAPP_XLOGO=y
BR2_PACKAGE_XAPP_XMORE=y
BR2_PACKAGE_XAPP_XRANDR=y
BR2_PACKAGE_XAPP_XREFRESH=y
BR2_PACKAGE_XAPP_XSET=y
BR2_PACKAGE_XAPP_XSETMODE=y
BR2_PACKAGE_XAPP_XSETPOINTER=y
BR2_PACKAGE_XAPP_XSM=y
BR2_PACKAGE_XDRIVER_XF86_INPUT_EVDEV=y
BR2_PACKAGE_XDRIVER_XF86_INPUT_JOYSTICK=y
BR2_PACKAGE_XDRIVER_XF86_INPUT_LIBINPUT=y
BR2_PACKAGE_XDRIVER_XF86_INPUT_MOUSE=y
BR2_PACKAGE_XDRIVER_XF86_INPUT_TSLIB=y
BR2_PACKAGE_XFONT_FONT_XFREE86_TYPE1=y
BR2_PACKAGE_ALSAMIXERGUI=y
BR2_PACKAGE_DILLO=y
BR2_PACKAGE_DOCKER=y
BR2_PACKAGE_XTERM=y
BR2_PACKAGE_XVKBD=y
BR2_PACKAGE_FLUXBOX=y
BR2_PACKAGE_LINUX_FIRMWARE=y
BR2_PACKAGE_EVEMU=y
BR2_PACKAGE_EVTEST=y
BR2_PACKAGE_USBUTILS=y
BR2_PACKAGE_TCL=y
BR2_PACKAGE_ALSA_PLUGINS=y
BR2_PACKAGE_PORTAUDIO=y
BR2_PACKAGE_PORTAUDIO_OSS=y
BR2_PACKAGE_PORTAUDIO_CXX=y
BR2_PACKAGE_CA_CERTIFICATES=y
BR2_PACKAGE_GNUTLS_OPENSSL=y
BR2_PACKAGE_GNUTLS_TOOLS=y
BR2_PACKAGE_GNUTLS_ENABLE_SSL2=y
BR2_PACKAGE_LIBB2=y
BR2_PACKAGE_LIBSHA1=y
BR2_PACKAGE_LIBOPENSSL_BIN=y
BR2_PACKAGE_LIBOPENSSL_ENGINES=y
BR2_PACKAGE_LEVELDB=y
BR2_PACKAGE_SQLITE=y
BR2_PACKAGE_LIBFUSE3=y
BR2_PACKAGE_OPENJPEG=y
BR2_PACKAGE_PANGO=y
BR2_PACKAGE_WAYLAND=y
BR2_PACKAGE_WAYLAND_UTILS=y
BR2_PACKAGE_WEBP_DEMUX=y
BR2_PACKAGE_WOFF2=y
BR2_PACKAGE_DTC=y
BR2_PACKAGE_DTC_PROGRAMS=y
BR2_PACKAGE_LIBXKBCOMMON=y
BR2_PACKAGE_LIBXSLT=y
BR2_PACKAGE_LOG4CPP=y
BR2_PACKAGE_LIBOPENH264=y
BR2_PACKAGE_CPPZMQ=y
BR2_PACKAGE_LIBCURL=y
BR2_PACKAGE_LIBCURL_CURL=y
BR2_PACKAGE_DOUBLE_CONVERSION=y
BR2_PACKAGE_FFTW=y
BR2_PACKAGE_FFTW_SINGLE=y
BR2_PACKAGE_GSL=y
BR2_PACKAGE_STARTUP_NOTIFICATION=y
BR2_PACKAGE_VOLK=y
BR2_PACKAGE_NCURSES_TARGET_PROGS=y
BR2_PACKAGE_BMON=y
BR2_PACKAGE_CRDA=y
BR2_PACKAGE_DHCPCD=y
BR2_PACKAGE_DNSMASQ=y
BR2_PACKAGE_DNSMASQ_DNSSEC=y
BR2_PACKAGE_DNSMASQ_IDN=y
BR2_PACKAGE_DNSMASQ_CONNTRACK=y
BR2_PACKAGE_DROPBEAR=y
BR2_PACKAGE_HOSTAPD=y
BR2_PACKAGE_HOSTAPD_EAP=y
BR2_PACKAGE_HOSTAPD_WPS=y
BR2_PACKAGE_HOSTAPD_WPA3=y
BR2_PACKAGE_IPTABLES=y
BR2_PACKAGE_IPUTILS=y
BR2_PACKAGE_IW=y
BR2_PACKAGE_LYNX=y
BR2_PACKAGE_NETWORK_MANAGER=y
BR2_PACKAGE_NETWORK_MANAGER_TUI=y
BR2_PACKAGE_NETWORK_MANAGER_CLI=y
BR2_PACKAGE_WIRELESS_TOOLS=y
BR2_PACKAGE_WIRELESS_TOOLS_LIB=y
BR2_PACKAGE_WPA_SUPPLICANT=y
BR2_PACKAGE_WPA_SUPPLICANT_AUTOSCAN=y
BR2_PACKAGE_WPA_SUPPLICANT_CLI=y
BR2_PACKAGE_WPA_SUPPLICANT_WPA_CLIENT_SO=y
BR2_PACKAGE_WPA_SUPPLICANT_PASSPHRASE=y
BR2_PACKAGE_OPTEE_CLIENT=y
BR2_PACKAGE_LOCKFILE_PROGS=y
BR2_PACKAGE_SCREEN=y
BR2_PACKAGE_DAEMON=y
BR2_PACKAGE_SEATD=y
BR2_PACKAGE_UTIL_LINUX_FSCK=y
BR2_PACKAGE_NANO=y
BR2_TARGET_ROOTFS_EXT2=y
BR2_TARGET_ROOTFS_EXT2_4=y
BR2_TARGET_ROOTFS_EXT2_SIZE="512M"
# BR2_TARGET_ROOTFS_TAR is not set
BR2_TARGET_ARM_TRUSTED_FIRMWARE=y
BR2_TARGET_ARM_TRUSTED_FIRMWARE_CUSTOM_TARBALL=y
BR2_TARGET_ARM_TRUSTED_FIRMWARE_CUSTOM_TARBALL_LOCATION="$(call github,STMicroelectronics,arm-trusted-firmware)v2.8-stm32mp-r1.tar.gz"
BR2_TARGET_ARM_TRUSTED_FIRMWARE_PLATFORM="stm32mp1"
BR2_TARGET_ARM_TRUSTED_FIRMWARE_CUSTOM_DTS_PATH="$(BR2_EXTERNAL_STM32MP135_Dev_Board_Buildroot_PATH)/board/stm32mp135_dev_board/stm32mp135_dev_board-tf-a.dts $(BR2_EXTERNAL_STM32MP135_Dev_Board_Buildroot_PATH)/board/stm32mp135_dev_board/stm32mp135_dev_board-tf-a.dtsi $(BR2_EXTERNAL_STM32MP135_Dev_Board_Buildroot_PATH)/board/stm32mp135_dev_board/stm32mp135_dev_board-tf-a-fw-config.dts"
BR2_TARGET_ARM_TRUSTED_FIRMWARE_FIP=y
BR2_TARGET_ARM_TRUSTED_FIRMWARE_BL32_OPTEE=y
BR2_TARGET_ARM_TRUSTED_FIRMWARE_UBOOT_AS_BL33=y
BR2_TARGET_ARM_TRUSTED_FIRMWARE_ADDITIONAL_VARIABLES="STM32MP_SDMMC=1 AARCH32_SP=optee DTB_FILE_NAME=stm32mp135_dev_board-tf-a.dtb BL33_CFG=$(BINARIES_DIR)/u-boot.dtb"
BR2_TARGET_ARM_TRUSTED_FIRMWARE_DEBUG=y
BR2_TARGET_ARM_TRUSTED_FIRMWARE_IMAGES="*.stm32 fip.bin"
BR2_TARGET_ARM_TRUSTED_FIRMWARE_NEEDS_DTC=y
BR2_TARGET_OPTEE_OS=y
BR2_TARGET_OPTEE_OS_CUSTOM_TARBALL=y
BR2_TARGET_OPTEE_OS_CUSTOM_TARBALL_LOCATION="$(call github,STMicroelectronics,optee_os)3.19.0-stm32mp-r1.tar.gz"
BR2_TARGET_OPTEE_OS_NEEDS_DTC=y
BR2_TARGET_OPTEE_OS_NEEDS_PYTHON_CRYPTOGRAPHY=y
BR2_TARGET_OPTEE_OS_PLATFORM="stm32mp1"
BR2_TARGET_OPTEE_OS_CUSTOM_DTS_PATH="$(BR2_EXTERNAL_STM32MP135_Dev_Board_Buildroot_PATH)/board/stm32mp135_dev_board/stm32mp135_dev_board-optee.dts"
BR2_TARGET_OPTEE_OS_ADDITIONAL_VARIABLES="CFG_EMBED_DTB_SOURCE_FILE=stm32mp135_dev_board-optee.dts CFG_STM32MP13=y CFG_WITH_TUI=n CFG_DRAM_SIZE=0x10000000 CFG_SHMEM_SIZE=0x200000 STM32MP_USB_PROGRAMMER=1"
BR2_TARGET_UBOOT=y
BR2_TARGET_UBOOT_BUILD_SYSTEM_KCONFIG=y
BR2_TARGET_UBOOT_CUSTOM_TARBALL=y
BR2_TARGET_UBOOT_CUSTOM_TARBALL_LOCATION="$(call github,STMicroelectronics,u-boot)v2022.10-stm32mp-r1.1.tar.gz"
BR2_TARGET_UBOOT_BOARD_DEFCONFIG="stm32mp13"
BR2_TARGET_UBOOT_NEEDS_PYLIBFDT=y
BR2_TARGET_UBOOT_NEEDS_OPENSSL=y
BR2_TARGET_UBOOT_FORMAT_DTB=y
BR2_TARGET_UBOOT_CUSTOM_DTS_PATH="$(BR2_EXTERNAL_STM32MP135_Dev_Board_Buildroot_PATH)/board/stm32mp135_dev_board/stm32mp135_dev_board.dts $(BR2_EXTERNAL_STM32MP135_Dev_Board_Buildroot_PATH)/board/stm32mp135_dev_board/stm32mp135_dev_board-u-boot.dtsi"
BR2_TARGET_UBOOT_CUSTOM_MAKEOPTS="dtb-y=stm32mp135_dev_board.dtb DEVICE_TREE=stm32mp135_dev_board"
BR2_PACKAGE_HOST_GENIMAGE=y
BR2_PACKAGE_HOST_MESON_TOOLS=y
BR2_PACKAGE_HOST_PYTHON3=y
BR2_PACKAGE_HOST_SWIG=y
BR2_PACKAGE_HOST_UBOOT_TOOLS_FIT_SUPPORT=y
```
